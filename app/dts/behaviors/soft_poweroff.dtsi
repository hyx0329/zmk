/*
 * Copyright (c) 2023 The ZMK Contributors
 *
 * SPDX-License-Identifier: MIT
 */

#include <dt-bindings/zmk/soft_poweroff.h>

/ {
    behaviors {
        soft_poweroff: behavior_soft_poweroff {
            compatible = "zmk,behavior-soft-poweroff";
            label = "SOFT_POWEROFF";
            #binding-cells = <0>;
        };

        sleep: behavior_sleep {
            compatible = "zmk,behavior-soft-poweroff";
            label = "SLEEP";
            type = <WAKABLE>;
            #binding-cells = <0>;
        };
    };
};
