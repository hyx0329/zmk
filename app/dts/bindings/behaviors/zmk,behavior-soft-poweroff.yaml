## app/dts/bindings/behaviors/zmk,behavior-soft-poweroff.yaml
```yaml
# Copyright (c) 2023 The ZMK Contributors
# SPDX-License-Identifier: MIT

description: Keyboard System Soft Off Behavior

compatible: "zmk,behavior-soft-poweroff"

include: zero_param.yaml
```
